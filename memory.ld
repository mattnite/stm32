MEMORY {
	ROM : ORIGIN = 0x08000000, LENGTH = 192K
	EEPROM : ORIGIN = 0x08080000, LENGTH = 6K
	RAM : ORIGIN = 0x20000000, LENGTH = 20K
}

REGION_ALIAS("REGION_VECTOR_TABLE", ROM);
REGION_ALIAS("REGION_TEXT", ROM);
REGION_ALIAS("REGION_RODATA", EEPROM);
REGION_ALIAS("REGION_DATA", RAM);
REGION_ALIAS("REGION_BSS", RAM);
